## package/flops/Config.in
```kconfig
config BR2_PACKAGE_FLOPS
	bool "flops"
	help
	  benchmark floating-point 'MFLOPS' rating for the FADD, FSUB, FMUL, and FDIV operations based on specific 'instruction mixes'
```

## package/gpio_app/Config.in
```kconfig
config BR2_PACKAGE_GPIO_APP
	bool "GPIO app"
        depends on BR2_PACKAGE_GPIO
	default n
	help
	  Demonstrate the usage of GPIO consumer driver by toggling on board LED
```

## package/hsetroot/Config.in
```kconfig
config BR2_PACKAGE_HSETROOT
	bool "hsetroot"
	select BR2_PACKAGE_IMLIB2
	select BR2_PACKAGE_IMLIB2_JPEG
	select BR2_PACKAGE_IMLIB2_PNG
	help
	  Yet another wallpaper application
```

## package/ifx-wifi-fw/Config.in
```kconfig
config BR2_PACKAGE_IFX_WIFI_FW
    bool "Infineon Wi-Fi firmware"
    help
      Infineon Wi-Fi firmware download. Firmwares will be downloaded
      into /lib/firmware/cypress/ folder.
```

## package/ifx-wifi-nvram/Config.in
```kconfig
config BR2_PACKAGE_IFX_WIFI_NVRAM
    bool "Infineon Wi-Fi firmware NVRAM"
    help
      NVRAM files for Infineon/Cypress WiFi chipsets.
      File will be downloaded into /lib/firmware/cypress/ folder.
```

## package/ifx-wifi/Config.in
```kconfig
config BR2_PACKAGE_IFX_WIFI
    bool "Infineon backports kernel modules"
    select BR2_PACKAGE_IFX_WIFI_FW
    select BR2_PACKAGE_IFX_WIFI_NVRAM
    depends on BR2_LINUX_KERNEL
    help
      Infineon backports kernel modules (brcmfmac, etc.) built against
      the target kernel.
      IFX-backports version: 2026_0108 Release
```

## package/linpack/Config.in
```kconfig
config BR2_PACKAGE_LINPACK
	bool "linpack"
	help
	  LINPACK Benchmarks are a measure of a system's floating point computing power.
	  LINPACK is a software library for performing numerical linear algebra on digital computers
```

## package/llamacpp/Config.in
```kconfig
config BR2_PACKAGE_LLAMACPP
	bool "llama.cpp"
	depends on BR2_INSTALL_LIBSTDCPP
	depends on BR2_TOOLCHAIN_GCC_AT_LEAST_8 # C++17 filesystem
	select BR2_GCC_ENABLE_OPENMP
	help
	  LLM inference in C/C++
```

## package/opensbi-ext/Config.in
```kconfig
config BR2_TARGET_OPENSBI_PLAT_PATH
        string "OpenSBI Out of tree plateform"
        default ""
        help
          Enable OpenSBI Out of tree plateform
```

## package/picom/Config.in
```kconfig
config BR2_PACKAGE_PICOM
	bool "picom"
	select BR2_PACKAGE_LIBEV
	select BR2_PACKAGE_LIBCONFIG
	select BR2_PACKAGE_UTHASH
	select BR2_PACKAGE_DBUS
	help
	  A lightweight compositor for X11 with animation support
```

## package/polybar/Config.in
```kconfig
config BR2_PACKAGE_POLYBAR
	bool "polybar"
	select BR2_PACKAGE_IW
	select BR2_PACKAGE_XCB_UTIL_WM
	help
	  A fast and easy-to-use status bar
```

## package/raystone/Config.in
```kconfig
config BR2_PACKAGE_RAYSTONE
	bool "raystone"
	default n
	help
	  Sample program which use raytracer 
```

## package/rofi/Config.in
```kconfig
config BR2_PACKAGE_ROFI
	bool "rofi"
	select BR2_PACKAGE_STARTUP_NOTIFICATION
	select BR2_STARTUP_NOTIFICATION_VERSION_0_12
	select BR2_PACKAGE_LIBXKBCOMMON
	help
	  A window switcher, application launcher and dmenu replacement
```

## package/sample_video/Config.in
```kconfig
config BR2_PACKAGE_SAMPLE_VIDEO
	bool "sample video"
	default n
	depends on BR2_PACKAGE_FFMPEG
	help
	  Sample videos for processing using ffmpeg
```

## package/scrot/Config.in
```kconfig
config BR2_PACKAGE_SCROT
	bool "scrot"
	select BR2_PACKAGE_IMLIB2
	select BR2_PACKAGE_GIBLIB
	help
	  scrot (SCReen shOT) is a simple commandline screen capture utility
```

## package/socket_hello_world/Config.in
```kconfig
config BR2_PACKAGE_SOCKET_HELLO_WORLD
	bool "socket hello world"
	default n
	help
	  A simple client/server application of socket programming.
```

## package/spi_app/Config.in
```kconfig
config BR2_PACKAGE_SPI_APP
	bool "spi_app"
	help
	  Sample application to read and write to SPI flash device
```

## package/tcp/Config.in
```kconfig
config BR2_PACKAGE_TCP
	bool "tcp"
	help
	  Simple tcp client/server application
```

## package/tiny_encryption/Config.in
```kconfig
config BR2_PACKAGE_TINY_ENCRYPTION
	bool "tiny encryption"
	help
	  Tiny encryption demo using RISC-V custom instruction
```

## package/viewnior/Config.in
```kconfig
config BR2_PACKAGE_VIEWNIOR
	bool "viewnior"
	select BR2_PACKAGE_EXIV2
	select BR2_PACKAGE_EXIV2_PNG
	select BR2_PACKAGE_SHARED_MIME_INFO
	help
	  Elegant Image Viewer
```

## package/windowlist/Config.in
```kconfig
config BR2_PACKAGE_WINDOWLIST
	bool "windowlist"
	depends on BR2_PACKAGE_POLYBAR
	select BR2_PACKAGE_XAPP_XPROP
	select BR2_PACKAGE_WMCTRL
	help
	  Polybar custom module - List all open windows, click to switch focus or minimize
```
