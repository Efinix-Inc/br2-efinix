## boards/efinix/common/u-boot/uboot_32_defconfig
```kconfig
# 32-bit specific: Disable compressed extension
# CONFIG_RISCV_ISA_C is not set

CONFIG_TEXT_BASE=0x2040000
CONFIG_SYS_TEXT_BASE=0x02040000
CONFIG_DEBUG_UART_BASE=0xF8010000

CONFIG_BOOTCOMMAND="setenv kernel_addr_r 0x08000000;setenv fdt_addr_r 0x09000000;setenv fdt_high 0xffffffffffffffff;fatload mmc 0:1 ${kernel_addr_r} Image;fatload mmc 0:1 ${fdt_addr_r} linux.dtb;booti ${kernel_addr_r} - ${fdt_addr_r}"
CONFIG_VEXRISCV_TIMER=y
```

## boards/efinix/common/u-boot/uboot_64_defconfig
```kconfig
# 64-bit specific architecture and ISA settings
CONFIG_ARCH_RV64I=y
CONFIG_RISCV_ISA_A=y
CONFIG_RISCV_ISA_C=y
CONFIG_CMODEL_MEDANY=y

CONFIG_TEXT_BASE=0x802040000
CONFIG_SYS_TEXT_BASE=0x8002040000
CONFIG_DEBUG_UART_BASE=0x08030000

CONFIG_BOOTCOMMAND="setenv kernel_addr_r 0x808000000;setenv fdt_addr_r 0x809000000;setenv fdt_high 0xffffffffffffffff;fatload mmc 0:1 ${kernel_addr_r} Image;fatload mmc 0:1 ${fdt_addr_r} linux.dtb;booti ${kernel_addr_r} - ${fdt_addr_r}"
```

## boards/efinix/t120f324/u-boot/uboot_defconfig
```kconfig
CONFIG_RISCV_ISA_A=y
CONFIG_RISCV_ISA_C=y
CONFIG_RISCV_ISA_F=y
CONFIG_RISCV_ISA_D=y
```

## boards/efinix/ti375n1156/opensbi/Kconfig
```kconfig
# SPDX-License-Identifier: BSD-2-Clause

config PLATFORM_TI375N1156
	bool
	select IPI_MSWI
	select SERIAL_SPINAL
	select IRQCHIP_PLIC
	select SERIAL_UART8250
	select TIMER_MTIMER
	default y
```

## boards/efinix/ti60f225/opensbi/Kconfig
```kconfig
# SPDX-License-Identifier: BSD-2-Clause

config PLATFORM_TI60F225
	bool
	select IPI_MSWI
	select SERIAL_SPINAL
	select IRQCHIP_PLIC
	select SERIAL_UART8250
	select TIMER_MTIMER
	default y
```

## configs/efinix_ti375c529_defconfig
```kconfig
# Instruction Set Extensions
BR2_riscv_custom=y
BR2_RISCV_ISA_RVM=y
BR2_RISCV_ISA_RVA=y
BR2_RISCV_ISA_RVC=y
BR2_RISCV_ISA_RVF=y
BR2_RISCV_ISA_RVD=y

# OpenSBI
BR2_TARGET_OPENSBI_PLAT="ti375c529"
BR2_TARGET_OPENSBI_PLAT_PATH="$(BR2_EXTERNAL_EFINIX_PATH)/boards/efinix/ti375c529/opensbi"

# U-Boot
BR2_TARGET_UBOOT_CUSTOM_VERSION=y
BR2_TARGET_UBOOT_CUSTOM_VERSION_VALUE="2025.01"
BR2_TARGET_UBOOT_VERSION="2025.01"
BR2_TARGET_UBOOT_CUSTOM_CONFIG_FILE="$(BR2_EXTERNAL_EFINIX_PATH)/boards/efinix/common/u-boot/uboot_base_defconfig"
BR2_TARGET_UBOOT_CUSTOM_DTS_PATH="$(BR2_EXTERNAL_EFINIX_PATH)/boards/efinix/ti375c529/u-boot/uboot.dts $(BR2_EXTERNAL_EFINIX_PATH)/boards/efinix/common/dts/sapphire.dtsi"

# Kernel
BR2_LINUX_KERNEL_CUSTOM_CONFIG_FILE="$(BR2_EXTERNAL_EFINIX_PATH)/boards/efinix/ti375c529/linux/linux.config"
BR2_LINUX_KERNEL_CUSTOM_DTS_PATH="$(BR2_EXTERNAL_EFINIX_PATH)/boards/efinix/ti375c529/linux/linux.dts $(BR2_EXTERNAL_EFINIX_PATH)/boards/efinix/common/dts/sapphire.dtsi"

# Rootfs
BR2_ROOTFS_POST_SCRIPT_ARGS="ti375c529"
```

## configs/kernel_5_10_defconfig
```kconfig
# GCC
BR2_GCC_VERSION_8_X=y

# Linux headers
BR2_PACKAGE_HOST_LINUX_HEADERS_CUSTOM_5_10=y

# Kernel
BR2_LINUX_KERNEL_CUSTOM_VERSION_VALUE="5.10.147"
BR2_LINUX_KERNEL_PATCH="$(BR2_EXTERNAL_EFINIX_PATH)/patches/linux/v5.10"
```

## configs/kernel_6_6_defconfig
```kconfig
# GCC
BR2_GCC_VERSION_14_X=y
BR2_BINUTILS_VERSION_2_44_X=y
BR2_BINUTILS_VERSION="2.44"

# Linux headers
BR2_PACKAGE_HOST_LINUX_HEADERS_CUSTOM_6_6=y

# Kernel
BR2_LINUX_KERNEL_CUSTOM_VERSION_VALUE="6.6.110"
BR2_LINUX_KERNEL_PATCH="$(BR2_EXTERNAL_EFINIX_PATH)/patches/linux/6.6"
```

## kernel_modules/efinix_ti375_remoteproc/Config.in
```kconfig
config BR2_PACKAGE_EFINIX_TI375_REMOTEPROC
            bool "Efinix TI375 RemoteProc kernel module"
            depends on BR2_LINUX_KERNEL
            default n
            help
              Efinix TI375 RISC-V AMP RemoteProc platform driver.
```

## kernel_modules/gpio_irq/Config.in
```kconfig
config BR2_PACKAGE_GPIO_IRQ
	bool "gpio interrupt kernel module"
	depends on BR2_LINUX_KERNEL
	help
	  gpio interrupt kernel module
```

## package/gpiod/Config.in
```kconfig
config BR2_PACKAGE_GPIOD
	bool "GPIOD"
	default n
	select BR2_PACKAGE_LIBGPIOD
	help
	  Toggling LEDs on board using libgpiod library
```

## package/openamp_app/Config.in
```kconfig
config BR2_PACKAGE_OPENAMP_APP
	bool "OpenAMP rpmsg demo app"
	depends on BR2_PACKAGE_EFINIX_TI375_REMOTEPROC
	help
	  User-space rpmsg-char client for the Efinix AMP demo.
```
