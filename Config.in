## Config.in
```kconfig
source "$BR2_EXTERNAL_EFINIX_PATH/package/opensbi-ext/Config.in"
source "$BR2_EXTERNAL_EFINIX_PATH/package/canny/Config.in"
source "$BR2_EXTERNAL_EFINIX_PATH/package/apb3app/Config.in"
source "$BR2_EXTERNAL_EFINIX_PATH/package/gpio_app/Config.in"
source "$BR2_EXTERNAL_EFINIX_PATH/package/cv2_tracking/Config.in"
source "$BR2_EXTERNAL_EFINIX_PATH/package/cv2_detection/Config.in"
source "$BR2_EXTERNAL_EFINIX_PATH/package/socket_hello_world/Config.in"
source "$BR2_EXTERNAL_EFINIX_PATH/package/evsoc_app/Config.in"
source "$BR2_EXTERNAL_EFINIX_PATH/package/evsoc_camera/Config.in"
source "$BR2_EXTERNAL_EFINIX_PATH/package/c-ray/Config.in"
source "$BR2_EXTERNAL_EFINIX_PATH/package/sample_video/Config.in"
source "$BR2_EXTERNAL_EFINIX_PATH/package/raystone/Config.in"
source "$BR2_EXTERNAL_EFINIX_PATH/package/tcp/Config.in"
source "$BR2_EXTERNAL_EFINIX_PATH/package/tiny_encryption/Config.in"
source "$BR2_EXTERNAL_EFINIX_PATH/package/emmc_programmer/Config.in"
source "$BR2_EXTERNAL_EFINIX_PATH/package/linpack/Config.in"
source "$BR2_EXTERNAL_EFINIX_PATH/package/spi_app/Config.in"
source "$BR2_EXTERNAL_EFINIX_PATH/package/flops/Config.in"
source "$BR2_EXTERNAL_EFINIX_PATH/package/fir_filter/Config.in"
source "$BR2_EXTERNAL_EFINIX_PATH/package/polybar/Config.in"
source "$BR2_EXTERNAL_EFINIX_PATH/package/picom/Config.in"
source "$BR2_EXTERNAL_EFINIX_PATH/package/uthash/Config.in"
source "$BR2_EXTERNAL_EFINIX_PATH/package/rofi/Config.in"
source "$BR2_EXTERNAL_EFINIX_PATH/package/windowlist/Config.in"
source "$BR2_EXTERNAL_EFINIX_PATH/package/viewnior/Config.in"
source "$BR2_EXTERNAL_EFINIX_PATH/package/scrot/Config.in"
source "$BR2_EXTERNAL_EFINIX_PATH/package/llamacpp/Config.in"
source "$BR2_EXTERNAL_EFINIX_PATH/package/desktop_environment/Config.in"
source "$BR2_EXTERNAL_EFINIX_PATH/package/hsetroot/Config.in"
source "$BR2_EXTERNAL_EFINIX_PATH/kernel_modules/helloworld/Config.in"
source "$BR2_EXTERNAL_EFINIX_PATH/kernel_modules/apb3/Config.in"
source "$BR2_EXTERNAL_EFINIX_PATH/kernel_modules/gpio/Config.in"
source "$BR2_EXTERNAL_EFINIX_PATH/kernel_modules/i2c/Config.in"
source "$BR2_EXTERNAL_EFINIX_PATH/kernel_modules/evsoc/Config.in"
```

## board/efinix/t120f324/u-boot/uboot_defconfig
```kconfig
CONFIG_RISCV=y
CONFIG_SMP=n
CONFIG_NR_CPUS=1
CONFIG_SBI_V01=y
#CONFIG_SYS_TEXT_BASE=0x80F00000
CONFIG_SYS_TEXT_BASE=0x01040000
CONFIG_NR_DRAM_BANKS=1
CONFIG_SPL=n
CONFIG_DEBUG_UART_BASE=0xF8010000
CONFIG_DEBUG_UART_CLOCK=50000000
CONFIG_DEBUG_UART=y
CONFIG_TARGET_VEXRISCV_SAXON=y
CONFIG_SPL_TEXT_BASE=0x81F00000
CONFIG_RISCV_SMODE=y
CONFIG_SPL_RISCV_SMODE=y
# CONFIG_RISCV_ISA_C is not set
CONFIG_EXTRA_ENV_SETTINGS="miaou"
CONFIG_DISTRO_DEFAULTS=y
CONFIG_BOOTDELAY=2
#CONFIG_BOOTCOMMAND="load mmc 0:1 0x00001000 uImage;load mmc 0:1 0x00FF1000 dtb;bootm 0x0001000 - 0x00FF1000"
CONFIG_BOOTCOMMAND="load mmc 0:1 0x00100000 uImage;load mmc 0:1 0x00CF0000 linux.dtb;bootm 0x00100000 - 0x00CF0000"
#CONFIG_BOOTDELAY=0
#CONFIG_BOOTCOMMAND="bootm 0x80000000 0x80FFFFC0 0x80FF0000"
CONFIG_SPL_OS_BOOT=y
CONFIG_SPL_PAYLOAD=""
CONFIG_SPL_RAM_SUPPORT=y
CONFIG_SPL_RAM_DEVICE=y
CONFIG_CMD_MMC=y
CONFIG_CMD_SPI=y
CONFIG_CMD_TIMER=y
CONFIG_PARTITIONS=y
CONFIG_BLK=y
CONFIG_OF_EMBED=y
CONFIG_DEFAULT_DEVICE_TREE="uboot"
CONFIG_MMC=y
CONFIG_MMC_BROKEN_CD=y
CONFIG_MMC_SPI=y
CONFIG_MMC_SPI_CRC_ON=y
CONFIG_RISCV_SBI_SERIAL=y
CONFIG_DEBUG_UART_RISCV_SBI=y
CONFIG_SPI=y
CONFIG_VEXRISCV_SPI=y
CONFIG_RISCV_TIMER=y
CONFIG_MMC_TRACE=n
CONFIG_FS_EXT4=y
CONFIG_SYS_MALLOC_F_LEN=0x8000

# ENV in SDCARD
CONFIG_CMD_EXT4_WRITE=y
CONFIG_ENV_IS_IN_EXT4=y
CONFIG_ENV_EXT4_INTERFACE="mmc"
CONFIG_ENV_EXT4_DEVICE_AND_PART="0:1"
CONFIG_ENV_EXT4_FILE="/uboot.env"

#CONFIG_ENV_IS_IN_SPI_FLASH=y
CONFIG_CMD_SPI=y
CONFIG_DM_SPI=y
CONFIG_MTD=y
CONFIG_CMD_MTD=y
CONFIG_DM_MTD=y
CONFIG_DM_SPI_FLASH=y
CONFIG_SPI_FLASH_MTD=y
CONFIG_SPI_FLASH_SFDP_SUPPORT=y
CONFIG_SPI_FLASH_WINBOND=y
CONFIG_SPI_FLASH_ISSI=y
CONFIG_SPI_FLASH_SPANSION=y

CONFIG_MTDIDS_DEFAULT="nor0=nor0"
CONFIG_MTDPARTS_DEFAULT="mtdparts=nor0:4m(fpga_bitstream),512k(opensbi),512k(uboot),11m(user)"
CONFIG_ENV_SIZE=0x10000
CONFIG_ENV_OFFSET=0x500000
CONFIG_ENV_SECT_SIZE=0x10000
```

## boards/efinix/common/u-boot/uboot_base_defconfig
```kconfig
# Core RISC-V configuration - common to all
CONFIG_RISCV=y
CONFIG_SYS_TEXT_BASE=0x01040000
CONFIG_SYS_MALLOC_F_LEN=0x8000
CONFIG_ENV_SIZE=0x10000
CONFIG_NR_DRAM_BANKS=1
CONFIG_DEBUG_UART=y
CONFIG_DEBUG_UART_BASE=0xF8010000
CONFIG_DEBUG_UART_CLOCK=50000000
CONFIG_TARGET_VEXRISCV_SAXON=y
CONFIG_RISCV_SMODE=y

# Common commands - needed by all variants
CONFIG_CMD_MMC=y
CONFIG_CMD_MTD=y
CONFIG_CMD_SPI=y
CONFIG_CMD_TIMER=y
CONFIG_CMD_EXT2=y
CONFIG_CMD_EXT4=y
CONFIG_CMD_EXT4_WRITE=y
CONFIG_CMD_FAT=y

# MTD configuration - common
CONFIG_MTDIDS_DEFAULT="nor0=nor0"
CONFIG_MTDPARTS_DEFAULT="mtdparts=nor0:4m(fpga_bitstream),512k(opensbi),512k(uboot),11m(user)"

# Device tree - common
CONFIG_OF_EMBED=y
CONFIG_DEFAULT_DEVICE_TREE="uboot"

# MMC basic support - common
CONFIG_MMC=y
CONFIG_MMC_BROKEN_CD=y
CONFIG_MMC_SPI=y

# SPI Flash - common
CONFIG_DM_MTD=y
CONFIG_SPI_FLASH_SFDP_SUPPORT=y
CONFIG_SPI_FLASH_ISSI=y
CONFIG_SPI_FLASH_SPANSION=y
CONFIG_SPI_FLASH_WINBOND=y
CONFIG_SPI_FLASH_MTD=y

# Serial/Debug - common
CONFIG_DEBUG_UART_RISCV_SBI=y
CONFIG_RISCV_SBI_SERIAL=y

# SPI support - common
CONFIG_SPI=y
CONFIG_VEXRISCV_SPI=y
CONFIG_SBI_V01=y

# MMC driver - common
CONFIG_MMC_SDHCI_EFX=y
CONFIG_MMC_EFX_EMMC=y

# Device model and watchdog - common
CONFIG_DM=y
CONFIG_WDT=y
CONFIG_WATCHDOG=y
CONFIG_SPL_WATCHDOG_SUPPORT=y
CONFIG_WDT_EFINIX=y

# System reset - common
CONFIG_SIFIVE_CLINT=y
CONFIG_SYSRESET=y
CONFIG_SYSRESET_WATCHDOG=y
```

## boards/efinix/common/u-boot/uboot_emmc_defconfig
```kconfig
# eMMC specific settings - disable distro defaults for custom boot
# CONFIG_DISTRO_DEFAULTS is not set
CONFIG_USE_DEFAULT_ENV_FILE=y
CONFIG_DEFAULT_ENV_FILE="board/vexriscv/saxon/default_env.txt"

# Environment stored in SPI flash for eMMC
CONFIG_ENV_OFFSET=0x780000
CONFIG_ENV_SECT_SIZE=0x10000
CONFIG_ENV_IS_IN_SPI_FLASH=y
CONFIG_ENV_ADDR=0x0
# CONFIG_USE_ENV_SPI_BUS is not set
# CONFIG_USE_ENV_SPI_CS is not set
# CONFIG_USE_ENV_SPI_MAX_HZ is not set
# CONFIG_USE_ENV_SPI_MODE is not set
# CONFIG_ENV_SPI_EARLY is not set

# Ensure environment variables are set correctly
CONFIG_EXTRA_ENV_SETTINGS=y
```

## boards/efinix/ti180j484/u-boot/uboot_defconfig
```kconfig
CONFIG_RISCV=y
CONFIG_SYS_TEXT_BASE=0x01040000
CONFIG_SYS_MALLOC_F_LEN=0x8000
CONFIG_ENV_SIZE=0x10000
CONFIG_NR_DRAM_BANKS=1
CONFIG_DEBUG_UART=y
CONFIG_DEBUG_UART_BASE=0xF8010000
CONFIG_DEBUG_UART_CLOCK=50000000
CONFIG_TARGET_VEXRISCV_SAXON=y
CONFIG_RISCV_SMODE=y
# CONFIG_RISCV_ISA_C is not set
CONFIG_DISTRO_DEFAULTS=y
CONFIG_BOOTCOMMAND="load mmc 0:1 0x00400000 uImage;load mmc 0:1 0x00CF0000 linux.dtb;bootm 0x00400000 - 0x00CF0000"
CONFIG_CMD_MMC=y
CONFIG_CMD_MTD=y
CONFIG_CMD_SPI=y
CONFIG_CMD_TIMER=y
CONFIG_CMD_EXT4_WRITE=y
CONFIG_MTDIDS_DEFAULT="nor0=nor0"
CONFIG_MTDPARTS_DEFAULT="mtdparts=nor0:4m(fpga_bitstream),512k(opensbi),512k(uboot),11m(user)"
CONFIG_OF_EMBED=y
CONFIG_DEFAULT_DEVICE_TREE="uboot"
CONFIG_ENV_IS_IN_FAT=y
CONFIG_ENV_FAT_INTERFACE="mmc"
CONFIG_ENV_FAT_DEVICE_AND_PART="0:1"
CONFIG_ENV_FAT_FILE="/uboot.env"
CONFIG_MMC=y
CONFIG_MMC_BROKEN_CD=y
CONFIG_MMC_SPI=y
CONFIG_DM_MTD=y
CONFIG_SPI_FLASH_SFDP_SUPPORT=y
CONFIG_SPI_FLASH_ISSI=y
CONFIG_SPI_FLASH_SPANSION=y
CONFIG_SPI_FLASH_WINBOND=y
CONFIG_SPI_FLASH_MTD=y
CONFIG_DEBUG_UART_RISCV_SBI=y
CONFIG_RISCV_SBI_SERIAL=y
CONFIG_SPI=y
CONFIG_VEXRISCV_SPI=y
CONFIG_SBI_V01=y
CONFIG_MMC_SDHCI_EFX=y
```

## configs/base_defconfig
```kconfig
# Compilation cache
BR2_CCACHE=y
BR2_CCACHE_DIR="$(HOME)/.buildroot-ccache"
BR2_DL_DIR="$(HOME)/.buildroot-dl"

# Target options
BR2_riscv=y

# Toolchain                                                                                                               
BR2_TOOLCHAIN_USES_GLIBC=y                                                                                                
BR2_TOOLCHAIN_BUILDROOT_GLIBC=y                                                                                           
BR2_TOOLCHAIN_BUILDROOT_LIBC="glibc"                                                                                      

# Glibc Options                                                                                                           
BR2_PACKAGE_GLIBC=y

# GCC
BR2_GCC_VERSION_8_X=y
BR2_OPTIMIZE_2=y
BR2_TOOLCHAIN_BUILDROOT_CXX=y
BR2_GCC_ENABLE_OPENMP=y
BR2_GCC_CROSS_CXX=y
BR2_INSTALL_LIBSTDCPP=y

# System
BR2_TARGET_GENERIC_GETTY=y
BR2_TARGET_GENERIC_GETTY_PORT="ttySL0"
BR2_TARGET_GENERIC_GETTY_BAUDRATE_115200=y

# Filesystem
BR2_TARGET_ROOTFS_CPIO=y
BR2_TARGET_ROOTFS_EXT2=y
BR2_TARGET_ROOTFS_EXT2_SIZE="200M"

BR2_PACKAGE_HOST_GENIMAGE=y

# Linux headers
BR2_PACKAGE_HOST_LINUX_HEADERS_CUSTOM_5_10=y

# Kernel
BR2_LINUX_KERNEL=y
BR2_LINUX_KERNEL_CUSTOM_VERSION=y
BR2_LINUX_KERNEL_CUSTOM_VERSION_VALUE="5.10.147"
BR2_LINUX_KERNEL_PATCH="$(BR2_EXTERNAL_EFINIX_PATH)/patches/linux/v5.10"
BR2_LINUX_KERNEL_USE_CUSTOM_CONFIG=y
BR2_LINUX_KERNEL_VMLINUX=y
BR2_LINUX_KERNEL_DTS_SUPPORT=y

# Rootfs customisation
BR2_ROOTFS_OVERLAY="$(BR2_EXTERNAL_EFINIX_PATH)/boards/efinix/common/rootfs_overlay"
BR2_ROOTFS_POST_BUILD_SCRIPT="$(BR2_EXTERNAL_EFINIX_PATH)/boards/efinix/common/post_build.sh"
BR2_ROOTFS_POST_IMAGE_SCRIPT="$(BR2_EXTERNAL_EFINIX_PATH)/boards/efinix/common/post_create_fs.sh"

# U-BOOT
BR2_TARGET_UBOOT=y
BR2_TARGET_ROOTFS_CPIO_UIMAGE=y
BR2_TARGET_UBOOT_BUILD_SYSTEM_KCONFIG=y
BR2_TARGET_UBOOT_USE_CUSTOM_CONFIG=y

# OPENSBI
BR2_TARGET_OPENSBI=y

# Patches
BR2_GLOBAL_PATCH_DIR="$(BR2_EXTERNAL_EFINIX_PATH)/patches/"
```

## configs/efinix_t120f324_defconfig
```kconfig
# Compilation cache
BR2_CCACHE=y
BR2_CCACHE_DIR="$(HOME)/.buildroot-ccache-saxon_default"
BR2_DL_DIR="$(HOME)/.buildroot-dl"

# Target options
BR2_riscv=y
BR2_RISCV_32=y

# Instruction Set Extensions
BR2_riscv_custom=y
BR2_RISCV_ISA_CUSTOM_RVM=y
BR2_RISCV_ISA_CUSTOM_RVA=y
BR2_RISCV_ISA_CUSTOM_RVC=n
BR2_RISCV_ISA_CUSTOM_RVF=y
BR2_RISCV_ISA_CUSTOM_RVD=y
BR2_RISCV_ABI_ILP32D=y

# GCC
BR2_GCC_VERSION_8_X=y
BR2_OPTIMIZE_2=y

# System
BR2_TARGET_GENERIC_GETTY=y
BR2_TARGET_GENERIC_GETTY_PORT="hvc0"

# Filesystem
BR2_TARGET_ROOTFS_CPIO=y
BR2_TARGET_ROOTFS_EXT2=y
BR2_TARGET_ROOTFS_EXT2_SIZE="350M"

BR2_PACKAGE_HOST_GENIMAGE=y

# Net
#BR2_SYSTEM_DHCP="eth0"

# Linux headers
BR2_PACKAGE_HOST_LINUX_HEADERS_CUSTOM_5_10=y

# Kernel
BR2_LINUX_KERNEL=y
BR2_LINUX_KERNEL_LATEST_VERSION=n
BR2_LINUX_KERNEL_CUSTOM_VERSION=y
BR2_LINUX_KERNEL_CUSTOM_GIT=y
BR2_LINUX_KERNEL_CUSTOM_REPO_URL="https://github.com/torvalds/linux.git"
BR2_LINUX_KERNEL_CUSTOM_REPO_VERSION="v5.10"
BR2_LINUX_KERNEL_CUSTOM_VERSION_VALUE="v5.10"
BR2_LINUX_KERNEL_USE_CUSTOM_CONFIG=y
BR2_LINUX_KERNEL_CUSTOM_CONFIG_FILE="$(BR2_EXTERNAL_EFINIX_PATH)/boards/efinix/t120f324/linux/linux.config"
BR2_LINUX_KERNEL_VMLINUX=y
BR2_LINUX_KERNEL_DTS_SUPPORT=y
BR2_LINUX_KERNEL_CUSTOM_DTS_PATH="$(BR2_EXTERNAL_EFINIX_PATH)/boards/efinix/t120f324/linux/linux.dts $(BR2_EXTERNAL_EFINIX_PATH)/boards/efinix/common/dts/sapphire.dtsi"

# Rootfs customisation
BR2_ROOTFS_OVERLAY="$(BR2_EXTERNAL_EFINIX_PATH)/boards/efinix/common/rootfs_overlay"
BR2_ROOTFS_POST_BUILD_SCRIPT="$(BR2_EXTERNAL_EFINIX_PATH)/boards/efinix/common/post_build.sh"
BR2_ROOTFS_POST_IMAGE_SCRIPT="$(BR2_EXTERNAL_EFINIX_PATH)/boards/efinix/common/post_create_fs.sh"
BR2_ROOTFS_POST_SCRIPT_ARGS="t120f324"

# U-BOOT
BR2_TARGET_UBOOT=y
BR2_TARGET_ROOTFS_CPIO_UIMAGE=y
BR2_TARGET_UBOOT_BUILD_SYSTEM_KCONFIG=y
BR2_TARGET_UBOOT_USE_CUSTOM_CONFIG=y
BR2_TARGET_UBOOT_CUSTOM_CONFIG_FILE="$(BR2_EXTERNAL_EFINIX_PATH)/boards/efinix/t120f324/u-boot/uboot_defconfig"
BR2_TARGET_UBOOT_CUSTOM_DTS_PATH="$(BR2_EXTERNAL_EFINIX_PATH)/boards/efinix/t120f324/u-boot/uboot.dts"

# OPENSBI
BR2_TARGET_OPENSBI=y
BR2_TARGET_OPENSBI_PLAT="t120f324"
BR2_TARGET_OPENSBI_PLAT_PATH="$(BR2_EXTERNAL_EFINIX_PATH)/boards/efinix/t120f324/opensbi"

# Flashing
BR2_PACKAGE_MTD=y
BR2_PACKAGE_MTD_FLASH_ERASE=y
BR2_PACKAGE_MTD_TESTS=y
BR2_PACKAGE_MTD_FLASH_SPEED=y
BR2_PACKAGE_MTD_FLASH_TORTURE=y

# Extra packages
BR2_PACKAGE_DHRYSTONE=y
BR2_PACKAGE_MICROPYTHON=n
BR2_PACKAGE_PYTHON=n
BR2_PACKAGE_PYTHON_SPIDEV=n
BR2_PACKAGE_SL=y
BR2_PACKAGE_HELLO=n
BR2_PACKAGE_NANO=y

BR2_PACKAGE_LMBENCH=y
BR2_PACKAGE_RAMSPEED=y
BR2_PACKAGE_STRESS_NG=y

BR2_GCC_CROSS_CXX=y
BR2_INSTALL_LIBSTDCPP=y
BR2_PACKAGE_IPERF=y
BR2_PACKAGE_IPERF3=y

BR2_PACKAGE_HTOP=y
BR2_PACKAGE_LYNX=y
BR2_PACKAGE_LINKS=y

BR2_PACKAGE_LIBATOMIC_OPS_ARCH_SUPPORTS=n
BR2_PACKAGE_LIBATOMIC_OPS=n
BR2_PACKAGE_OPENSSL=n
BR2_PACKAGE_LIBOPENSSL=n
BR2_PACKAGE_OPENSSH=n

BR2_PACKAGE_RNG_TOOLS=n
BR2_PACKAGE_HAVEGED=n

BR2_PACKAGE_DROPBEAR=y
BR2_PACKAGE_SSHPASS=y

BR2_PACKAGE_BUSYBOX_SHOW_OTHERS=n
BR2_PACKAGE_BASH=n

# Patches
BR2_GLOBAL_PATCH_DIR="$(BR2_EXTERNAL_EFINIX_PATH)/patches/"

# Kernel module
BR2_PACKAGE_HELLOWORLD=y
```
