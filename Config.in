## configs/efinix_ti180j484_defconfig
```kconfig
# Compilation cache
BR2_CCACHE=y
BR2_CCACHE_DIR="$(HOME)/.buildroot-ccache-saxon_default"
BR2_DL_DIR="$(HOME)/.buildroot-dl"

# Target options
BR2_riscv=y
BR2_RISCV_32=y

# Instruction Set Extensions
BR2_riscv_custom=y
BR2_RISCV_ISA_CUSTOM_RVM=y
BR2_RISCV_ISA_CUSTOM_RVA=y
BR2_RISCV_ISA_CUSTOM_RVC=n
BR2_RISCV_ISA_CUSTOM_RVF=y
BR2_RISCV_ISA_CUSTOM_RVD=y
BR2_RISCV_ABI_ILP32D=y

# GCC
BR2_GCC_VERSION_8_X=y
BR2_OPTIMIZE_2=y
BR2_TOOLCHAIN_BUILDROOT_CXX=y
BR2_GCC_ENABLE_OPENMP=y
BR2_GCC_CROSS_CXX=y
BR2_INSTALL_LIBSTDCPP=y

# System
BR2_TARGET_GENERIC_GETTY=y
BR2_TARGET_GENERIC_GETTY_PORT="ttySL0"
BR2_TARGET_GENERIC_GETTY_BAUDRATE_115200=y

# Filesystem
BR2_TARGET_ROOTFS_CPIO=y
BR2_TARGET_ROOTFS_EXT2=y
BR2_TARGET_ROOTFS_EXT2_SIZE="1G"

BR2_PACKAGE_HOST_GENIMAGE=y

# Linux headers
BR2_PACKAGE_HOST_LINUX_HEADERS_CUSTOM_5_10=y

# Kernel
BR2_LINUX_KERNEL=y
BR2_LINUX_KERNEL_LATEST_VERSION=n
BR2_LINUX_KERNEL_CUSTOM_VERSION=y
BR2_LINUX_KERNEL_CUSTOM_GIT=y
BR2_LINUX_KERNEL_CUSTOM_REPO_URL="https://github.com/torvalds/linux.git"
BR2_LINUX_KERNEL_CUSTOM_REPO_VERSION="v5.10"
BR2_LINUX_KERNEL_CUSTOM_VERSION_VALUE="v5.10"
BR2_LINUX_KERNEL_USE_CUSTOM_CONFIG=y
BR2_LINUX_KERNEL_CUSTOM_CONFIG_FILE="$(BR2_EXTERNAL_EFINIX_PATH)/boards/efinix/ti180j484/linux/linux.config"
BR2_LINUX_KERNEL_VMLINUX=y
BR2_LINUX_KERNEL_DTS_SUPPORT=y
BR2_LINUX_KERNEL_CUSTOM_DTS_PATH="$(BR2_EXTERNAL_EFINIX_PATH)/boards/efinix/ti180j484/linux/linux.dts $(BR2_EXTERNAL_EFINIX_PATH)/boards/efinix/common/dts/sapphire.dtsi"

# Rootfs customisation
BR2_ROOTFS_OVERLAY="$(BR2_EXTERNAL_EFINIX_PATH)/boards/efinix/common/rootfs_overlay"
BR2_ROOTFS_POST_BUILD_SCRIPT="$(BR2_EXTERNAL_EFINIX_PATH)/boards/efinix/common/post_build.sh"
BR2_ROOTFS_POST_IMAGE_SCRIPT="$(BR2_EXTERNAL_EFINIX_PATH)/boards/efinix/common/post_create_fs.sh"
BR2_ROOTFS_POST_SCRIPT_ARGS="ti180j484"

# U-BOOT
BR2_TARGET_UBOOT=y
BR2_TARGET_ROOTFS_CPIO_UIMAGE=y
BR2_TARGET_UBOOT_BUILD_SYSTEM_KCONFIG=y
BR2_TARGET_UBOOT_USE_CUSTOM_CONFIG=y
BR2_TARGET_UBOOT_CUSTOM_CONFIG_FILE="$(BR2_EXTERNAL_EFINIX_PATH)/boards/efinix/ti180j484/u-boot/uboot_defconfig"
BR2_TARGET_UBOOT_CUSTOM_DTS_PATH="$(BR2_EXTERNAL_EFINIX_PATH)/boards/efinix/ti180j484/u-boot/uboot.dts $(BR2_EXTERNAL_EFINIX_PATH)/boards/efinix/common/dts/sapphire.dtsi"

# OPENSBI
BR2_TARGET_OPENSBI=y
BR2_TARGET_OPENSBI_PLAT="ti180j484"
BR2_TARGET_OPENSBI_PLAT_PATH="$(BR2_EXTERNAL_EFINIX_PATH)/boards/efinix/ti180j484/opensbi"

# Flashing
BR2_PACKAGE_MTD=y
BR2_PACKAGE_MTD_FLASH_ERASE=y
BR2_PACKAGE_MTD_TESTS=y
BR2_PACKAGE_MTD_FLASH_SPEED=y
BR2_PACKAGE_MTD_FLASH_TORTURE=y

# Patches
BR2_GLOBAL_PATCH_DIR="$(BR2_EXTERNAL_EFINIX_PATH)/patches/"

# Networking tools
BR2_PACKAGE_DROPBEAR=y
BR2_PACKAGE_ETHTOOL=y
BR2_PACKAGE_NET_TOOLS=y
BR2_PACKAGE_SOCKET_HELLO_WORLD=y

BR2_PACKAGE_UTIL_LINUX=y
BR2_PACKAGE_UTIL_LINUX_SCHEDUTILS=y
BR2_PACKAGE_UTIL_LINUX_BINARIES=y

BR2_PACKAGE_BUSYBOX_SHOW_OTHERS=y
BR2_PACKAGE_VIM=y
BR2_PACKAGE_VIM_RUNTIME=y
BR2_PACKAGE_NANO=y

# Benchmark
BR2_PACKAGE_DHRYSTONE=y
BR2_PACKAGE_COREMARK=y
BR2_PACKAGE_COREMARK_PRO=y
BR2_PACKAGE_IPERF=y
BR2_PACKAGE_IPERF3=y
BR2_PACKAGE_LMBENCH=y
BR2_PACKAGE_RAMSPEED=y
BR2_PACKAGE_STRESS_NG=y
BR2_PACKAGE_HTOP=y
BR2_PACKAGE_RAYSTONE=y
BR2_PACKAGE_C_RAY=y
BR2_PACKAGE_DROPWATCH=y
BR2_PACKAGE_DSTAT=y
BR2_PACKAGE_FIO=y
BR2_PACKAGE_LATENCYTOP=y
BR2_PACKAGE_NETPERF=y
BR2_PACKAGE_NMON=y
BR2_PACKAGE_BMON=y
BR2_PACKAGE_RAMSMP=y
BR2_PACKAGE_RT_TESTS=y
BR2_PACKAGE_STRESS=y
BR2_PACKAGE_TINYMEMBENCH=y
BR2_PACKAGE_WHETSTONE=y
BR2_PACKAGE_FLOPS=y

BR2_PACKAGE_PYTHON3=y

# Kernel modules
BR2_PACKAGE_HELLOWORLD=y
BR2_PACKAGE_SPI_APP=y
BR2_PACKAGE_GPIO=y
BR2_PACKAGE_GPIO_APP=y
BR2_PACKAGE_I2C=y
BR2_PACKAGE_I2C_TOOLS=y

# Extra applications
BR2_PACKAGE_TINY_ENCRYPTION=y
BR2_PACKAGE_SAMPLE_VIDEO=y
BR2_PACKAGE_SOCKET_HELLO_WORLD=y

BR2_PACKAGE_OPENCV3=y
BR2_PACKAGE_OPENCV3_LIB_IMGCODECS=y
BR2_PACKAGE_OPENCV3_LIB_IMGPROC=y
BR2_PACKAGE_OPENCV3_LIB_OBJDETECT=y
BR2_PACKAGE_OPENCV3_LIB_PHOTO=y
BR2_PACKAGE_OPENCV3_LIB_VIDEOIO=y
BR2_PACKAGE_OPENCV3_LIB_VIDEO=y
BR2_PACKAGE_OPENCV3_BUILD_TESTS=y
BR2_PACKAGE_OPENCV3_BUILD_PERF_TESTS=y
BR2_PACKAGE_OPENCV3_WITH_JPEG=y
BR2_PACKAGE_OPENCV3_INSTALL_DATA=y
BR2_PACKAGE_OPENCV3_LIB_PYTHON=y
BR2_PACKAGE_OPENCV3_WITH_GTK=y
BR2_PACKAGE_OPENCV3_WITH_GTK3=y
BR2_PACKAGE_OPENCV3_DNN=y
BR2_PACKAGE_OPENCV3_LIB_HIGHGUI=y
BR2_PACKAGE_OPENCV3_WITH_GSTREAMER1=y
BR2_PACKAGE_OPENCV3_WITH_FFMPEG=y
BR2_PACKAGE_OPENCV3_WITH_PNG=y
BR2_PACKAGE_OPENCV3_WITH_V4L=y
# BR2_PACKAGE_OPENCV3_GUI_NONE is not set

BR2_PACKAGE_CV2_DETECTION=y
BR2_PACKAGE_CV2_TRACKING=y
BR2_PACKAGE_CANNY=y
```

## configs/efinix_ti60f225_defconfig
```kconfig
# Instruction Set Extensions
BR2_riscv_custom=y
BR2_RISCV_ISA_CUSTOM_RVM=y
BR2_RISCV_ISA_CUSTOM_RVA=y
BR2_RISCV_ISA_CUSTOM_RVC=y
BR2_RISCV_ISA_CUSTOM_RVF=y
BR2_RISCV_ISA_CUSTOM_RVD=y

# OpenSBI
BR2_TARGET_OPENSBI_PLAT="ti60f225"
BR2_TARGET_OPENSBI_PLAT_PATH="$(BR2_EXTERNAL_EFINIX_PATH)/boards/efinix/ti60f225/opensbi"

# U-Boot
BR2_TARGET_UBOOT_CUSTOM_CONFIG_FILE="$(BR2_EXTERNAL_EFINIX_PATH)/boards/efinix/common/u-boot/uboot_base_defconfig"
BR2_TARGET_UBOOT_CUSTOM_DTS_PATH="$(BR2_EXTERNAL_EFINIX_PATH)/boards/efinix/ti60f225/u-boot/uboot.dts $(BR2_EXTERNAL_EFINIX_PATH)/boards/efinix/common/dts/sapphire.dtsi"

# Kernel
BR2_LINUX_KERNEL_CUSTOM_CONFIG_FILE="$(BR2_EXTERNAL_EFINIX_PATH)/boards/efinix/ti60f225/linux/linux.config"
BR2_LINUX_KERNEL_CUSTOM_DTS_PATH="$(BR2_EXTERNAL_EFINIX_PATH)/boards/efinix/ti60f225/linux/linux.dts $(BR2_EXTERNAL_EFINIX_PATH)/boards/efinix/common/dts/sapphire.dtsi"

# Rootfs
BR2_ROOTFS_POST_SCRIPT_ARGS="ti60f225"
```

## kernel_modules/apb3/Config.in
```kconfig
config BR2_PACKAGE_APB3
	bool "simple APB3 kernel module"
	depends on BR2_LINUX_KERNEL
	help
	  simple APB3 kernenl module sample
```

## kernel_modules/evsoc/Config.in
```kconfig
config BR2_PACKAGE_EVSOC
	bool "simple EVSOC kernel module"
	depends on BR2_LINUX_KERNEL
	help
	  simple EVSOC kernenl module sample
```

## kernel_modules/gpio/Config.in
```kconfig
config BR2_PACKAGE_GPIO
	bool "GPIO consumer kernel module"
	depends on BR2_LINUX_KERNEL
	default n
	help
	  GPIO consumer driver
```

## kernel_modules/helloworld/Config.in
```kconfig
config BR2_PACKAGE_HELLOWORLD
	bool "helloworld kernel module"
	depends on BR2_LINUX_KERNEL
	help
	  hello world kernel module
```

## kernel_modules/i2c/Config.in
```kconfig
config BR2_MODULE_I2C
	bool "I2C bus driver kernel module"
	depends on BR2_LINUX_KERNEL
	default n
	help
	  Efinix I2C bus device driver for Linux
```

## package/apb3app/Config.in
```kconfig
config BR2_PACKAGE_APB3APP
	bool "Apb3 Application"
	default n
	depends on BR2_PACKAGE_APB3
	help
	  A sample program that use apb3 char driver
```

## package/canny/Config.in
```kconfig
config BR2_PACKAGE_CANNY
	bool "Canny image"
	default n
	depends on BR2_PACKAGE_OPENCV3
	help
	  A sample program that use OpenCV library to convert RGB image to canny image.
```

## package/cv2_detection/Config.in
```kconfig
config BR2_PACKAGE_CV2_DETECTION
	bool "CV2 Detection"
	default n
	depends on BR2_PACKAGE_OPENCV3
	help
	  A sample program that use OpenCV library and Mobilenet neural network to classify the object.
```

## package/cv2_tracking/Config.in
```kconfig
config BR2_PACKAGE_CV2_TRACKING
	bool "Canny image"
	default n
	depends on BR2_PACKAGE_OPENCV3
	help
	  A sample program that use OpenCV library to tracking of movement object.
```

## package/desktop_environment/Config.in
```kconfig
config BR2_PACKAGE_DESKTOP_ENVIRONMENT
	bool "desktop environment"
	select BR2_PACKAGE_XORG7
	select BR2_PACKAGE_XSERVER_XORG_SERVER
	select BR2_PACKAGE_XSERVER_XORG_SERVER_MODULAR
	select BR2_PACKAGE_XSERVER_XORG_SERVER_XVFB
	#select BR2_PACKAGE_XDRIVER_XF86_INPUT_EVDEV
	select BR2_PACKAGE_XDRIVER_XF86_INPUT_KEYBOARD
	select BR2_PACKAGE_XDRIVER_XF86_INPUT_MOUSE
	select BR2_PACKAGE_XDRIVER_XF86_VIDEO_FBDEV
	select BR2_PACKAGE_XDRIVER_XF86_VIDEO_DUMMY
	select BR2_PACKAGE_XLIB_LIBXCOMPOSITE
	select BR2_PACKAGE_XTERM
	select BR2_PACKAGE_XAPP_XRANDR
	select BR2_PACKAGE_XAPP_XRDB
	select BR2_PACKAGE_XAPP_XINIT
	select BR2_PACKAGE_XAPP_XMODMAP
	select BR2_PACKAGE_XAPP_XHOST
	select BR2_PACKAGE_XAPP_XCALC
	select BR2_PACKAGE_XAPP_VIEWRES
	select BR2_PACKAGE_XAPP_XCONSOLE
	select BR2_PACKAGE_XAPP_ICO
	select BR2_PACKAGE_XAPP_XCLIPBOARD
	select BR2_PACKAGE_XAPP_XCLOCK
	select BR2_PACKAGE_XAPP_XDPYINFO
	select BR2_PACKAGE_XAPP_XAUTH
	select BR2_PACKAGE_XAPP_SHOWFONT
	select BR2_PACKAGE_XAPP_XINPUT
	select BR2_PACKAGE_XAPP_SETXKBMAP
	select BR2_PACKAGE_XAPP_XKBEVD
	select BR2_PACKAGE_XAPP_XKBPRINT
	select BR2_PACKAGE_XAPP_XKBUTILS
	select BR2_PACKAGE_XAPP_XFONTSEL
	select BR2_PACKAGE_XAPP_XFS
	select BR2_PACKAGE_XAPP_XFSINFO
	select BR2_PACKAGE_XAPP_XMAG
	select BR2_PACKAGE_XAPP_XEDIT
	select BR2_PACKAGE_XAPP_XEV
	select BR2_PACKAGE_XAPP_XLOAD
	select BR2_PACKAGE_XAPP_TWM
	select BR2_PACKAGE_XAPP_XSET
	select BR2_PACKAGE_XKEYBOARD_CONFIG
	select BR2_PACKAGE_XFONT_FONT_BH_TTF
	select BR2_PACKAGE_XFONT_FONT_BH_TYPE1
	select BR2_PACKAGE_XFONT_FONT_XFREE86_TYPE1
	select BR2_PACKAGE_XFONT_FONT_BH_100DPI
	select BR2_PACKAGE_XFONT_FONT_BH_75DPI
	select BR2_PACKAGE_XCB_UTIL_CURSOR
	select BR2_PACKAGE_XLIB_LIBX11 
	select BR2_PACKAGE_OPENBOX
	select BR2_PACKAGE_PICOM
	select BR2_PACKAGE_POLYBAR
	select BR2_PACKAGE_WINDOWLIST
	select BR2_PACKAGE_HSETROOT
	select BR2_PACKAGE_ROFI
	select BR2_PACKAGE_FONT_AWESOME
	select BR2_PACKAGE_ADWAITA_ICON_THEME
	select BR2_PACKAGE_HICOLOR_ICON_THEME
	select BR2_PACKAGE_PCMANFM
	select BR2_PACKAGE_VIEWNIOR
	
	help
	  Contain configuration files for setting up desktop environment
```

## package/emmc_programmer/Config.in
```kconfig
config BR2_PACKAGE_EMMC_PROGRAMMER
	bool "eMMC Programmer"
	depends on BR2_PACKAGE_PYTHON3
	default n
	help
	  Python tool to create partitions and program images to eMMC device.
	  Supports TFTP download and automatic partitioning with verification
	  to distinguish between eMMC and SD card devices.
```

## package/evsoc_app/Config.in
```kconfig
config BR2_PACKAGE_EVSOC_APP
	bool "Evsoc Application"
	default n
	depends on BR2_PACKAGE_EVSOC
	help
	  A sample program that use evsoc char driver
```

## package/evsoc_camera/Config.in
```kconfig
config BR2_PACKAGE_EVSOC_CAMERA
	bool "EVSoC camera stream"
	default n
	depends on BR2_PACKAGE_EVSOC
	depends on BR2_GCC_ENABLE_OPENMP
	select BR2_PACKAGE_OPENCV3
	select BR2_PACKAGE_OPENCV3_LIB_HIGHGUI
	select BR2_PACKAGE_I2C
	help
	  A simple http server which serve camera stream output using mjpeg format for
	  Edge Vision SoC (EVSoC).
```

## package/fir_filter/Config.in
```kconfig
config BR2_PACKAGE_FIR_FILTER
	bool "FIR filter"
	help
	  Finite Impulse Response (FIR) is a digital filter used in the DSP application.
	  This application showcase the usage of RISC-V custom instruction to accelerate
	  the filter processing and compare it with software based implementation.
```
